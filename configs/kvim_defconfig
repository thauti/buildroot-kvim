## configs/kvim_defconfig
```kconfig
# Architecture
BR2_aarch64=y

# System
BR2_TARGET_GENERIC_HOSTNAME="kvim"
BR2_TARGET_ROOTFS_EXT2=y
BR2_ROOTFS_POST_IMAGE_SCRIPT="board/khadas/kvim/post-image.sh"
BR2_GCC_VERSION_4_9_X=y

# Kernel
BR2_KERNEL_HEADERS_VERSION=y
BR2_DEFAULT_KERNEL_VERSION="3.14.29"
BR2_PACKAGE_HOST_LINUX_HEADERS_CUSTOM_3_14=y
BR2_LINUX_KERNEL=y
BR2_LINUX_KERNEL_CUSTOM_TARBALL=y
BR2_LINUX_KERNEL_CUSTOM_TARBALL_LOCATION="$(call github,khadas,linux,e11b7335c061ea5d491206facb0cac6d7ab95d2c)/linux-e11b7335c061ea5d491206facb0cac6d7ab95d2c.tar.gz"
BR2_LINUX_KERNEL_PATCH="board/khadas/kvim/patches/0001-Linux-Remove-customer-directory.patch"
BR2_LINUX_KERNEL_DEFCONFIG="kvim"
BR2_LINUX_KERNEL_DTS_SUPPORT=y
BR2_LINUX_KERNEL_BUILD_DEFAULT_DTS=y
BR2_LINUX_KERNEL_USE_INTREE_DTS=y
BR2_LINUX_KERNEL_INTREE_DTS_NAME="kvim_linux"
BR2_LINUX_KERNEL_IMAGE=y

# U-Boot
BR2_TARGET_UBOOT=y
BR2_TARGET_UBOOT_CUSTOM_GIT=y
BR2_TARGET_UBOOT_CUSTOM_REPO_URL="https://github.com/khadas/u-boot.git"
BR2_TARGET_UBOOT_CUSTOM_REPO_VERSION="85683c0f43b5d5e405def72786ab2916e3779c6c"
BR2_TARGET_UBOOT_PATCH="board/khadas/kvim/patches/0001-Uboot-Add-a-copy-of-u-boot.sd.bin-to-the-root-folder.patch"
BR2_TARGET_UBOOT_FORMAT_BIN=n
BR2_TARGET_UBOOT_FORMAT_CUSTOM=y
BR2_TARGET_UBOOT_FORMAT_CUSTOM_NAME="u-boot.bin.sd.bin"
BR2_TARGET_UBOOT_BOARDNAME="kvim"

# Required tools to create the SD image
BR2_PACKAGE_HOST_DOSFSTOOLS=y
BR2_PACKAGE_HOST_GENIMAGE=y
BR2_PACKAGE_HOST_MTOOLS=y
```
